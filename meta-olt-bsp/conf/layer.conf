## meta-olt-bsp/conf/layer.conf
```bitbake
# We have a conf and classes directory, add to BBPATH
BBPATH .= ":${LAYERDIR}"

# We have a recipes-* directories, add to BBFILES
BBFILES += "${LAYERDIR}/recipes-*/*/*.bb \
	${LAYERDIR}/recipes-*/*/*.bbappend"

BBFILE_COLLECTIONS += "olt-bsp"
BBFILE_PATTERN_olt-bsp = "^${LAYERDIR}/"
BBFILE_PRIORITY_olt-bsp = "6"
```

## meta-olt-bsp/conf/machine/olt.conf
```bitbake
#@TYPE: Machine
#@NAME: olt-bsp

#@DESCRIPTION: Machine configuration for olt systems


PREFERRED_PROVIDER_virtual/kernel ?= "linux-yocto"
PREFERRED_VERSION_linux-yocto ?= "3.19%"


require conf/machine/include/qemu.inc
include conf/machine/include/tune-cortexa9.inc

EXTRA_IMAGEDEPENDS += "u-boot"

IMAGE_FSTYPES = "ext3"

SERIAL_CONSOLE = "115200 ttyAMA0"

KERNEL_IMAGETYPE = "uImage"

UBOOT_MACHINE = "vexpress_ca9x4_defconfig"
UBOOT_ENTRYPOINT = "0x60008000"
UBOOT_LOADADDRESS = "0x60008000"
KERNEL_EXTRA_ARGS += "LOADADDR=${UBOOT_ENTRYPOINT}"
```
